/*
 * oled.c — SSD1306 OLED display driver (128×64, I²C)
 *
 * Author: jayis1
 * License: GPL-2.0
 *
 * Drives the 0.96" SSD1306 OLED display over I²C2. The display shows
 * real-time status: battery, source/sink VBUS voltage/current, and
 * the current PD contract state.
 *
 * The SSD1306 has a 128×64 pixel display organized as 8 pages of
 * 128 bytes each. Each byte represents 8 vertical pixels.
 */

#include <stdint.h>
#include <string.h>
#include "board.h"
#include "registers.h"

/* ---- OLED I²C config ---- */
#define OLED_BUS     I2C2_BUS
#define OLED_ADDR    SSD1306_ADDR

/* ---- SSD1306 commands ---- */
#define SSD1306_SET_CONTRAST       0x81u
#define SSD1306_DISPLAY_ON         0xAFu
#define SSD1306_DISPLAY_OFF        0xAEu
#define SSD1306_SET_DISPLAY_START  0x40u
#define SSD1306_SET_SEGMENT_REMAP  0xA1u
#define SSD1306_SET_MULTIPLEX      0xA8u
#define SSD1306_SET_SCAN_DIR       0xC8u
#define SSD1306_SET_OFFSET         0xD3u
#define SSD1306_SET_COMPINS       0xDAu
#define SSD1306_SET_PRECHARGE     0xD9u
#define SSD1306_SET_VCOMH          0xDBu
#define SSD1306_SET_CLKDIV         0xD5u
#define SSD1306_CHARGE_PUMP        0x8Du
#define SSD1306_SET_PAGE_ADDR      0xB0u
#define SSD1306_SET_COL_LOW        0x00u
#define SSD1306_SET_COL_HIGH       0x10u
#define SSD1306_NORMAL_DISPLAY     0xA6u
#define SSD1306_INVERT_DISPLAY     0xA7u
#define SSD1306_SET_PAGE_RANGE     0x22u
#define SSD1306_SET_COL_RANGE      0x21u

/* ---- Display buffer (128×64 = 1024 bytes, 8 pages) ---- */
static uint8_t s_display_buf[SSD1306_WIDTH * SSD1306_HEIGHT / 8];

/* ---- Font: 5×7 ASCII (32-127) ---- */
static const uint8_t s_font5x7[][5] = {
    {0x00,0x00,0x00,0x00,0x00}, /* space */
    {0x00,0x00,0x5F,0x00,0x00}, /* ! */
    {0x00,0x07,0x00,0x07,0x00}, /* " */
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    {0x44,0x64,0x54,0x4C,0x44}, /* z */
};

/* ---- Send a command to the SSD1306 ---- */
static void oled_cmd(uint8_t cmd) {
    uint8_t buf[2] = { 0x00u, cmd }; /* Control byte = 0x00 (command) */
    i2c_write_reg(OLED_BUS, OLED_ADDR, 0x00u, &cmd, 1);
}

/* ---- Init the SSD1306 ---- */
void oled_init(void) {
    /* Reset the OLED (PB12, active low) */
    volatile uint32_t *bsrr = (volatile uint32_t *)(GPIOB_BASE + GPIO_BSRR_OFFSET);
    *bsrr = (1u << (12 + 16)); /* Reset low */
    delay_ms(10);
    *bsrr = (1u << 12);        /* Reset high */
    delay_ms(50);

    /* Init sequence */
    oled_cmd(SSD1306_DISPLAY_OFF);
    oled_cmd(SSD1306_SET_CLKDIV);  oled_cmd(0x80u);
    oled_cmd(SSD1306_SET_MULTIPLEX); oled_cmd(0x3Fu);
    oled_cmd(SSD1306_SET_OFFSET);   oled_cmd(0x00u);
    oled_cmd(SSD1306_SET_DISPLAY_START);
    oled_cmd(SSD1306_SET_SEGMENT_REMAP);
    oled_cmd(SSD1306_SET_SCAN_DIR);
    oled_cmd(SSD1306_SET_COMPINS);  oled_cmd(0x12u);
    oled_cmd(SSD1306_SET_CONTRAST); oled_cmd(0xCFu);
    oled_cmd(SSD1306_SET_PRECHARGE); oled_cmd(0xF1u);
    oled_cmd(SSD1306_SET_VCOMH);     oled_cmd(0x40u);
    oled_cmd(SSD1306_CHARGE_PUMP);   oled_cmd(0x14u);
    oled_cmd(SSD1306_NORMAL_DISPLAY);
    oled_cmd(SSD1306_DISPLAY_ON);

    memset(s_display_buf, 0, sizeof(s_display_buf));
}

/* ---- Clear the display ---- */
void oled_clear(void) {
    memset(s_display_buf, 0, sizeof(s_display_buf));
    /* Flush to display */
    for (uint8_t page = 0; page < 8; page++) {
        oled_cmd(SSD1306_SET_PAGE_ADDR + page);
        oled_cmd(SSD1306_SET_COL_LOW);
        oled_cmd(SSD1306_SET_COL_HIGH);
        for (uint8_t col = 0; col < SSD1306_WIDTH; col++) {
            uint8_t data = s_display_buf[page * SSD1306_WIDTH + col];
            i2c_write_burst(OLED_BUS, OLED_ADDR, &data, 1);
        }
    }
}

/* ---- Draw a single character at (x, y) ---- */
static void oled_draw_char(uint8_t x, uint8_t y, char c) {
    if (c < 32 || c > 127) c = 32;
    const uint8_t *glyph = s_font5x7[c - 32];
    uint8_t page = y / 8;
    uint8_t bit_offset = y % 8;

    for (uint8_t i = 0; i < 5; i++) {
        uint8_t col_data = glyph[i];
        if (x + i < SSD1306_WIDTH) {
            s_display_buf[page * SSD1306_WIDTH + x + i] |= (col_data << bit_offset);
            if (bit_offset > 0 && page < 7) {
                s_display_buf[(page + 1) * SSD1306_WIDTH + x + i] |=
                    (col_data >> (8 - bit_offset));
            }
        }
    }
}

/* ---- Draw text at (x, y) ---- */
void oled_draw_text(uint8_t x, uint8_t y, const char *text, uint8_t size) {
    (void)size; /* Only size 1 supported in this minimal driver */
    uint8_t cx = x;
    for (const char *p = text; *p; p++) {
        if (cx + 6 > SSD1306_WIDTH) break;
        oled_draw_char(cx, y, *p);
        cx += 6; /* 5 pixels + 1 pixel spacing */
    }
    /* Flush affected pages to display */
    uint8_t page_start = y / 8;
    uint8_t page_end = (y + 7) / 8;
    for (uint8_t page = page_start; page <= page_end && page < 8; page++) {
        oled_cmd(SSD1306_SET_PAGE_ADDR + page);
        oled_cmd(SSD1306_SET_COL_LOW);
        oled_cmd(SSD1306_SET_COL_HIGH);
        for (uint8_t col = 0; col < SSD1306_WIDTH; col++) {
            uint8_t data = s_display_buf[page * SSD1306_WIDTH + col];
            i2c_write_burst(OLED_BUS, OLED_ADDR, &data, 1);
        }
    }
}

/* ---- Draw a 3-line status display ---- */
void oled_draw_status(const char *line1, const char *line2, const char *line3) {
    oled_clear();
    oled_draw_text(0, 0,  line1, 1);
    oled_draw_text(0, 16, line2, 1);
    oled_draw_text(0, 32, line3, 1);
    oled_draw_text(0, 48, "by jayis1", 1);
}