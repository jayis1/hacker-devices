/*
 * vcsel_driver.c — VCSEL modulation control for optical injection (MITM)
 * Author: jayis1
 * Date:   2026-06-17
 *
 * Controls the VCSEL (Vertical Cavity Surface Emitting Laser) used for
 * optical injection in inline-couple and SFP+ pass-through modes.
 * The VCSEL injects modulated light into the fiber through the 2×2 coupler,
 * enabling MITM frame modification attacks.
 */

#include "vcsel_driver.h"
#include "cdr_driver.h"
#include "registers.h"
#include "board.h"
#include <string.h>

/* ---- Private state ---- */
static uint8_t vcsel_enabled = 0;
static uint8_t vcsel_bias_ma = VCSEL_BIAS_MA_DEFAULT;

/* ---- Helpers ---- */

static void delay_us(uint32_t us)
{
    volatile uint32_t count = us * 44;
    while (count--) __asm__ volatile ("nop");
}

static void delay_ms(uint32_t ms)
{
    while (ms--) delay_us(1000);
}

static void gpio_init_simple(uint8_t pin, uint8_t output, uint8_t func)
{
    IO_BANK0_GPIO_CTRL(pin) = func;
    uint32_t pad = PAD_IE | PAD_DRIVE_4MA;
    if (!output) pad |= PAD_OD;
    PADS_BANK0_GPIO(pin) = pad;
    if (output)
        SIO_GPIO_OE_SET = GPIO_BIT(pin);
    else
        SIO_GPIO_OE_CLR = GPIO_BIT(pin);
}

/* ---- VCSEL modulation control ---- */
/* The VCSEL modulation driver is controlled via:
 *  - PIN_VCSEL_EN: Enable/disable the laser driver IC
 *  - PIN_VCSEL_MOD_P/N: Differential modulation input from FPGA
 *  - Bias current: set via I2C DAC (shared with APD DAC bus, different address)
 *
 * The modulation signal is generated by the FPGA, which encodes the
 * injection frame data using 8b/10b encoding for the target line rate.
 */

#define VCSEL_DRIVER_I2C_ADDR  0x0C  /* I2C address of VCSEL bias DAC */

static void i2c0_init(void)
{
    /* Configure I2C0 pins */
    IO_BANK0_GPIO_CTRL(PIN_I2C_SCL) = GPIO_FUNC_I2C;
    IO_BANK0_GPIO_CTRL(PIN_I2C_SDA) = GPIO_FUNC_I2C;
    PADS_BANK0_GPIO(PIN_I2C_SCL) = PAD_IE | PAD_DRIVE_4MA;
    PADS_BANK0_GPIO(PIN_I2C_SDA) = PAD_IE | PAD_DRIVE_4MA;

    /* Reset I2C0 */
    PSM_FRCE_OFF |= PSM_I2C0;
    delay_us(10);
    PSM_FRCE_OFF &= ~PSM_I2C0;
    delay_us(100);

    /* Configure I2C0: Master, 100kHz standard mode */
    /* SCL high/low counts for 100kHz at 125MHz: ~625 cycles each */
    I2C0->ss_scl_hcnt = 625;
    I2C0->ss_scl_lcnt = 625;

    /* Enable I2C master */
    I2C0->enable = 1;
}

static int i2c0_write_byte(uint8_t addr, uint8_t reg, uint8_t value)
{
    /* Send: START | addr_W | reg | value | STOP */
    I2C0->tar = addr;

    /* Wait for TX FIFO not full */
    while (!(I2C0->status & I2C_STATUS_TFNF)) { }

    /* Write register address (no stop, no restart) */
    I2C0->data_cmd = reg;

    /* Wait for TX FIFO not full */
    while (!(I2C0->status & I2C_STATUS_TFNF)) { }

    /* Write data value (with stop) */
    I2C0->data_cmd = value | I2C_CMD_STOP;

    /* Wait for TX FIFO empty (transfer complete) */
    while (!(I2C0->status & I2C_STATUS_TFE)) { }

    return 0;
}

/* ---- Public API ---- */

void vcsel_init(void)
{
    /* Configure VCSEL enable pin as GPIO output, default low (disabled) */
    gpio_init_simple(PIN_VCSEL_EN, 1, GPIO_FUNC_SIO);
    SIO_GPIO_OUT_CLR = GPIO_BIT(PIN_VCSEL_EN);

    /* Configure VCSEL modulation pins as FPGA-driven (input from RP2040 side,
     * output from FPGA side). These are controlled by the FPGA's injection
     * engine, not directly by the RP2040. */
    gpio_init_simple(PIN_VCSEL_MOD_P, 0, GPIO_FUNC_NULL);
    gpio_init_simple(PIN_VCSEL_MOD_N, 0, GPIO_FUNC_NULL);

    /* Initialize I2C for bias current control */
    i2c0_init();

    /* Set default bias current (but don't enable laser yet) */
    vcsel_set_bias_ma(VCSEL_BIAS_MA_DEFAULT);

    vcsel_enabled = 0;
}

int vcsel_enable(void)
{
    /* Safety: only enable in inline or SFP+ modes (not bend-tap) */
    /* Mode check is done by the caller (main.c) */

    /* Set bias current before enabling to avoid inrush */
    vcsel_set_bias_ma(vcsel_bias_ma);
    delay_us(1000);

    /* Enable VCSEL driver IC */
    SIO_GPIO_OUT_SET = GPIO_BIT(PIN_VCSEL_EN);
    delay_us(5000);  /* 5ms warmup for VCSEL */

    /* Check FPGA VCSEL status */
    uint32_t fpga_status = fpga_get_status();
    if (!(fpga_status & FPGA_STATUS_VCSEL_OK)) {
        /* VCSEL bias monitor not reading expected current */
        SIO_GPIO_OUT_CLR = GPIO_BIT(PIN_VCSEL_EN);
        return -1;  /* VCSEL fault */
    }

    vcsel_enabled = 1;
    return 0;
}

void vcsel_disable(void)
{
    SIO_GPIO_OUT_CLR = GPIO_BIT(PIN_VCSEL_EN);
    vcsel_enabled = 0;
}

int vcsel_set_bias_ma(uint8_t ma)
{
    if (ma > 20) return -1;  /* Safety limit: max 20 mA */

    /* Map current to DAC code: 0-20 mA → 0-255
     * The VCSEL bias DAC has 8-bit resolution.
     * 0 mA = code 0, 20 mA = code 255
     */
    uint8_t dac_code = (uint8_t)((uint32_t)ma * 255 / 20);
    i2c0_write_byte(VCSEL_DRIVER_I2C_ADDR, 0x00, dac_code);

    vcsel_bias_ma = ma;
    return 0;
}

uint8_t vcsel_get_bias_ma(void)
{
    return vcsel_bias_ma;
}

uint8_t vcsel_is_active(void)
{
    return vcsel_enabled;
}

int vcsel_inject(const uint8_t *data, uint32_t len, uint32_t bitrate_mbps)
{
    if (!vcsel_enabled) return -1;
    if (len == 0 || len > 65535) return -2;

    /* The FPGA handles the actual modulation. We write the data to the
     * FPGA injection FIFO and trigger injection. */

    /* Write data to FPGA injection FIFO in 32-bit chunks */
    uint32_t words = (len + 3) / 4;
    for (uint32_t i = 0; i < words; i++) {
        uint32_t word = 0;
        for (int b = 0; b < 4; b++) {
            uint32_t byte_idx = i * 4 + b;
            if (byte_idx < len) {
                word |= ((uint32_t)data[byte_idx]) << (b * 8);
            }
        }
        fpga_reg_write(FPGA_REG_DATA_FIFO, word);
    }

    /* Trigger injection with specified bitrate */
    uint32_t ctrl = fpga_reg_read(FPGA_REG_CTRL);
    /* Bitrate is encoded in upper bits of ctrl (for FPGA config) */
    uint32_t rate_code = 0;
    switch (bitrate_mbps) {
        case 1:     rate_code = 0; break;
        case 1000:  rate_code = 1; break;
        case 10000: rate_code = 2; break;
        default:    return -3;  /* Unsupported bitrate */
    }
    ctrl = (ctrl & 0x00FFFFFF) | (rate_code << 24);
    fpga_reg_write(FPGA_REG_CTRL, ctrl | FPGA_CTRL_INJECT_EN);

    return 0;
}

int vcsel_inject_frame(const uint8_t *frame, uint32_t len)
{
    if (!vcsel_enabled) return -1;
    if (len < 14 || len > 65535) return -2;  /* Min Ethernet frame size */

    /* Determine link rate from FPGA */
    link_rate_t rate = fpga_get_link_rate();
    uint32_t bitrate = 1000;  /* Default to 1G */
    switch (rate) {
        case LINK_1G:     bitrate = 1000; break;
        case LINK_10G:    bitrate = 10000; break;
        case LINK_FC_8G:  bitrate = 8000; break;
        case LINK_FC_16G: bitrate = 16000; break;
        default:          return -3;  /* No link or unknown rate */
    }

    return vcsel_inject(frame, len, bitrate);
}

int vcsel_self_test(void)
{
    /* Test sequence:
     * 1. Enable VCSEL with minimum bias
     * 2. Check FPGA VCSEL_OK status (bias monitor)
     * 3. Modulate a test pattern
     * 4. Disable
     */
    uint8_t saved_bias = vcsel_bias_ma;

    vcsel_set_bias_ma(2);  /* 2 mA minimum safe current */
    delay_us(1000);

    SIO_GPIO_OUT_SET = GPIO_BIT(PIN_VCSEL_EN);
    delay_us(5000);

    uint32_t status = fpga_get_status();
    if (!(status & FPGA_STATUS_VCSEL_OK)) {
        SIO_GPIO_OUT_CLR = GPIO_BIT(PIN_VCSEL_EN);
        vcsel_set_bias_ma(saved_bias);
        return -1;  /* VCSEL not responding */
    }

    /* Modulate test pattern: 0xAA 0x55 repeated 32 times */
    uint8_t test_pattern[64];
    for (int i = 0; i < 64; i += 2) {
        test_pattern[i] = 0xAA;
        test_pattern[i + 1] = 0x55;
    }

    /* Use 1 Mbps for self-test (safe for any VCSEL) */
    int ret = vcsel_inject(test_pattern, 64, 1);

    delay_us(1000);

    /* Disable and restore */
    SIO_GPIO_OUT_CLR = GPIO_BIT(PIN_VCSEL_EN);
    vcsel_set_bias_ma(saved_bias);
    vcsel_enabled = 0;

    return ret;
}