/*
 * oled.c — SSD1306 0.96" OLED status display for CoilGrip
 *
 * Author:  jayis1
 * Copyright (C) 2026 jayis1
 * SPDX-License-Identifier: GPL-2.0
 *
 * Bit-banged SPI on PB8 (SCK) / PB9 (SDA) with PB5 as CS and PA15 as D/C.
 * 128x64 monochrome. We only draw text (5x7 font) for the status line.
 */

#include "board.h"
#include "registers.h"

#define OLED_WIDTH   128U
#define OLED_HEIGHT   64U
#define OLED_PAGES    (OLED_HEIGHT / 8)

static uint8_t g_fb[OLED_WIDTH * OLED_PAGES];

/* ---- Bit-bang SPI ----------------------------------------------------- */
static void oled_sck_lo(void) { GPIOB->BSRR = BIT(PIN_PB8 + 16); }
static void oled_sck_hi(void) { GPIOB->BSRR = BIT(PIN_PB8); }
static void oled_sda_lo(void) { GPIOB->BSRR = BIT(PIN_PB9 + 16); }
static void oled_sda_hi(void) { GPIOB->BSRR = BIT(PIN_PB9); }
static void oled_cs_lo(void)  { GPIOB->BSRR = BIT(PIN_PB5 + 16); }
static void oled_cs_hi(void)  { GPIOB->BSRR = BIT(PIN_PB5); }
static void oled_dc_lo(void)  { GPIOA->BSRR = BIT(PIN_PA15 + 16); }  /* command */
static void oled_dc_hi(void)  { GPIOA->BSRR = BIT(PIN_PA15); }      /* data */

static void oled_spi_write(uint8_t b)
{
    for (int i = 7; i >= 0; i--) {
        oled_sck_lo();
        if (b & BIT(i)) oled_sda_hi(); else oled_sda_lo();
        oled_sck_hi();
    }
}

static void oled_cmd(uint8_t c)
{
    oled_dc_lo();
    oled_cs_lo();
    oled_spi_write(c);
    oled_cs_hi();
}

static void oled_data(uint8_t d)
{
    oled_dc_hi();
    oled_cs_lo();
    oled_spi_write(d);
    oled_cs_hi();
}

/* ---- 5x7 font (printable ASCII subset) --------------------------------- */
static const uint8_t font5x7[96][5] = {
    {0x00,0x00,0x00,0x00,0x00}, /* space */
    {0x00,0x00,0x5F,0x00,0x00}, /* ! */
    {0x00,0x07,0x00,0x07,0x00}, /* " */
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    {0x02,0x01,0x02,0x04,0x02}, /* ~ */
};

/* ---- Init sequence ---------------------------------------------------- */
int oled_init(void)
{
    oled_cs_hi();
    oled_dc_lo();
    /* Standard SSD1306 128x64 init */
    static const uint8_t init[] = {
        0xAE, 0xD5, 0x80, 0xA8, 0x3F, 0xD3, 0x00, 0x40,
        0x8D, 0x14, 0xA1, 0xC8, 0xDA, 0x12, 0x81, 0xCF,
        0xD9, 0xF1, 0xDB, 0x40, 0xA4, 0xA6, 0xAF
    };
    for (uint16_t i = 0; i < sizeof(init); i++) oled_cmd(init[i]);
    for (uint16_t i = 0; i < sizeof(g_fb); i++) g_fb[i] = 0;
    return 0;
}

void oled_clear(void)
{
    for (uint16_t i = 0; i < sizeof(g_fb); i++) g_fb[i] = 0;
}

/* Draw a 5x7 glyph into the framebuffer at (x, page_row) */
static void draw_glyph(uint8_t x, uint8_t row, char c)
{
    if (c < ' ' || c > '~') c = '?';
    const uint8_t *g = font5x7[(uint8_t)c - ' '];
    if (x + 5 > OLED_WIDTH) return;
    for (uint8_t i = 0; i < 5; i++) {
        g_fb[(uint16_t)row * OLED_WIDTH + x + i] = g[i];
    }
    g_fb[(uint16_t)row * OLED_WIDTH + x + 5] = 0;  /* 1-pixel gap */
}

void oled_draw_str(uint8_t col, uint8_t row, const char *s)
{
    uint8_t x = col * 6;
    uint8_t r = row;
    while (*s) {
        draw_glyph(x, r, *s++);
        x += 6;
        if (x + 6 > OLED_WIDTH) { x = 0; r++; if (r >= OLED_PAGES) return; }
    }
}

void oled_draw_status(const char *mode, const char *state, int8_t coil_temp_c,
                      float current_a, float power_w)
{
    oled_clear();
    oled_draw_str(0, 0, "CoilGrip v1.0  jayis1");
    oled_draw_str(0, 1, "Mode:");
    if (mode) oled_draw_str(7, 1, mode);
    oled_draw_str(0, 2, "State:");
    if (state) oled_draw_str(7, 2, state);
    /* Line 3: coil temp + thermal status */
    char buf[24];
    int ti = (int)coil_temp_c;
    int tf = (coil_temp_c < 0) ? -ti : ti;
    /* Tiny manual int-to-string to avoid pulling in sprintf */
    int p = 0;
    if (coil_temp_c < 0) buf[p++] = '-';
    if (tf == 0) buf[p++] = '0';
    else {
        char tbuf[6]; int n = 0;
        while (tf) { tbuf[n++] = '0' + (tf % 10); tf /= 10; }
        while (n) buf[p++] = tbuf[--n];
    }
    buf[p++] = 'C'; buf[p] = 0;
    oled_draw_str(0, 3, "Coil:");
    oled_draw_str(6, 3, buf);
    /* Line 4: power/current */
    /* Simple fixed-point print for current/power (1 decimal) */
    int ia = (int)(current_a * 10.0f);
    int iw = (int)(power_w * 10.0f);
    p = 0;
    buf[p++] = 'I'; buf[p++] = '=';
    if (ia < 0) { buf[p++] = '-'; ia = -ia; }
    buf[p++] = '0' + (ia / 10); buf[p++] = '.'; buf[p++] = '0' + (ia % 10);
    buf[p++] = 'A'; buf[p] = 0;
    oled_draw_str(0, 4, buf);
    p = 0;
    buf[p++] = 'P'; buf[p++] = '=';
    if (iw < 0) { buf[p++] = '-'; iw = -iw; }
    buf[p++] = '0' + (iw / 10); buf[p++] = '.'; buf[p++] = '0' + (iw % 10);
    buf[p++] = 'W'; buf[p] = 0;
    oled_draw_str(0, 5, buf);
    /* Flush framebuffer to display */
    for (uint8_t pg = 0; pg < OLED_PAGES; pg++) {
        oled_cmd(0xB0 + pg);        /* page address */
        oled_cmd(0x00);             /* lower column */
        oled_cmd(0x10);             /* upper column */
        for (uint8_t x = 0; x < OLED_WIDTH; x++)
            oled_data(g_fb[(uint16_t)pg * OLED_WIDTH + x]);
    }
}