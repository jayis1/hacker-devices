/*
 * fpga_if.c — FPGA interface driver
 * PlasmaReaper Multi-Vector Fault Injection Toolkit
 *
 * Author: jayis1
 * License: GPL-2.0
 *
 * This driver manages communication with the Lattice iCE40UP5K FPGA
 * over SPI1. The FPGA handles the fast trigger-to-glitch path with
 * sub-10 ns latency, glitch shape generation, and trigger arbitration.
 * The MCU programs the FPGA's internal registers via SPI to set trigger
 * source, glitch parameters, and to arm/fire.
 */

#include "fpga_if.h"
#include "../registers.h"

/* ---- FPGA bitstream (embedded) ------------------------------------- */
/* In a real build, the bitstream would be stored in external flash
 * (MX25L3233F) and loaded on boot. Here we declare a placeholder
 * that represents the bitstream for compilation purposes. */
static const uint8_t fpga_bitstream[] = {
    /* This is a placeholder representing the iCE40 bitstream header.
     * The actual bitstream is generated by Yosys/nextpnr from the
     * FPGA Verilog source (provided in fpga/ directory). */
    0x7F, 0x45, 0x4C, 0x46, /* ELF-like header (not actual bitstream format,
                             * but serves as a compile-time placeholder) */
    0x00, 0x00, 0x00, 0x00,
    0x00, 0x00, 0x00, 0x00,
    0x00, 0x00, 0x00, 0x00,
};
#define FPGA_BITSTREAM_LEN (sizeof(fpga_bitstream))

/* ---- Private state ------------------------------------------------- */

static uint8_t g_fpga_status;
static bool g_fpga_ready;

/* ---- SPI helpers --------------------------------------------------- */

static void spi1_wait_tx(void)
{
    while (!(SPI1->SR & SPI_SR_TXE))
        ;
}

static void spi1_wait_rx(void)
{
    while (!(SPI1->SR & SPI_SR_RXNE))
        ;
}

static void spi1_wait_busy(void)
{
    while (SPI1->SR & SPI_SR_BSY)
        ;
}

static uint8_t spi1_transfer(uint8_t tx)
{
    spi1_wait_tx();
    *(volatile uint8_t *)&SPI1->DR = tx;
    spi1_wait_rx();
    return *(volatile uint8_t *)&SPI1->DR;
}

static void fpga_nss_low(void)
{
    GPIOA->BRR = BIT(FPGA_NSS_PIN); /* NSS low */
}

static void fpga_nss_high(void)
{
    GPIOA->BSRR = BIT(FPGA_NSS_PIN); /* NSS high */
}

/* ---- Initialization ------------------------------------------------ */

void fpga_init(void)
{
    /*
     * Configure SPI1 pins:
     *  PA5 = SCK  (AF5)
     *  PA6 = MISO (AF5)
     *  PA7 = MOSI (AF5)
     *  PA4 = NSS  (GPIO output, software-controlled)
     *  PA3 = CDONE (GPIO input)
     *  PA2 = CRESET (GPIO output)
     */

    /* SCK, MISO, MOSI as AF5 */
    gpio_config(GPIOA, FPGA_SPI_SCK_PIN, GPIO_MODE_AF, GPIO_OSPEED_VHIGH,
                GPIO_PUPD_NONE, 5);
    gpio_config(GPIOA, FPGA_SPI_MISO_PIN, GPIO_MODE_AF, GPIO_OSPEED_VHIGH,
                GPIO_PUPD_NONE, 5);
    gpio_config(GPIOA, FPGA_SPI_MOSI_PIN, GPIO_MODE_AF, GPIO_OSPEED_VHIGH,
                GPIO_PUPD_NONE, 5);

    /* NSS as push-pull output, default high */
    gpio_config(GPIOA, FPGA_NSS_PIN, GPIO_MODE_OUTPUT, GPIO_OSPEED_VHIGH,
                GPIO_PUPD_NONE, 0);
    fpga_nss_high();

    /* CDONE as input with pull-down */
    gpio_config(GPIOA, FPGA_CDONE_PIN, GPIO_MODE_INPUT, GPIO_OSPEED_LOW,
                GPIO_PUPD_PULLDOWN, 0);

    /* CRESET as output, default low */
    gpio_config(GPIOA, FPGA_CRESET_PIN, GPIO_MODE_OUTPUT, GPIO_OSPEED_LOW,
                GPIO_PUPD_NONE, 0);
    GPIOA->BRR = BIT(FPGA_CRESET_PIN); /* CRESET low */

    /* Configure SPI1: master, 8-bit, CPOL=1 CPHA=1, baud rate = PCLK/4 */
    SPI1->CR1 = 0;
    SPI1->CR2 = SPI_CR2_DS_8BIT | SPI_CR2_FRXTH;
    SPI1->CR1 = SPI_CR1_MSTR | SPI_CR1_SSM | SPI_CR1_SSI
              | SPI_CR1_CPOL | SPI_CR1_CPHA
              | SPI_CR1_BR_DIV4
              | SPI_CR1_SPE;

    g_fpga_ready = false;
    g_fpga_status = 0;
}

/* ---- Bitstream loading (iCE40 SPI configuration) ------------------- */

bool fpga_load_bitstream(void)
{
    /*
     * iCE40 configuration sequence:
     * 1. Assert CRESET (low) for > 200 ns
     * 2. De-assert CRESET
     * 3. Wait for CDONE to go low (optional)
     * 4. Send bitstream over SPI (with SS low)
     * 5. Send extra clock cycles (dummy bytes)
     * 6. Wait for CDONE to go high
     */

    /* Pulse CRESET low for 1 µs */
    GPIOA->BRR = BIT(FPGA_CRESET_PIN);
    /* delay ~1 µs at 550 MHz: ~550 cycles. Use a simple loop. */
    for (volatile int i = 0; i < 100; i++)
        ;
    GPIOA->BSRR = BIT(FPGA_CRESET_PIN); /* release CRESET */

    /* Wait a bit for the FPGA to be ready to accept config */
    for (volatile int i = 0; i < 1000; i++)
        ;

    /* Send the bitstream */
    fpga_nss_low();
    for (uint32_t i = 0; i < FPGA_BITSTREAM_LEN; i++) {
        spi1_transfer(fpga_bitstream[i]);
    }

    /* Send dummy bytes for internal initialization (~49 extra clocks) */
    for (int i = 0; i < 8; i++) {
        spi1_transfer(0x00);
    }
    fpga_nss_high();
    spi1_wait_busy();

    /* Wait for CDONE to go high (FPGA configured successfully) */
    for (volatile int timeout = 0; timeout < 100000; timeout++) {
        if (GPIOA->IDR & BIT(FPGA_CDONE_PIN)) {
            g_fpga_ready = true;
            g_fpga_status = FPGA_STATUS_CDONE;
            return true;
        }
    }

    /* CDONE did not go high — configuration failed */
    return false;
}

/* ---- Register access ----------------------------------------------- */

void fpga_write_reg(uint8_t reg, const uint8_t *data, uint8_t len)
{
    if (!g_fpga_ready)
        return;

    fpga_nss_low();
    spi1_transfer(0x80 | reg); /* write flag = 0x80 */
    for (uint8_t i = 0; i < len; i++) {
        spi1_transfer(data[i]);
    }
    fpga_nss_high();
    spi1_wait_busy();
}

void fpga_read_reg(uint8_t reg, uint8_t *data, uint8_t len)
{
    if (!g_fpga_ready) {
        for (uint8_t i = 0; i < len; i++)
            data[i] = 0;
        return;
    }

    fpga_nss_low();
    spi1_transfer(reg & 0x7F); /* read flag = 0x00 */
    for (uint8_t i = 0; i < len; i++) {
        data[i] = spi1_transfer(0x00);
    }
    fpga_nss_high();
    spi1_wait_busy();
}

/* ---- Trigger control ----------------------------------------------- */

void fpga_arm_trigger(trigger_source_t source, uint32_t offset_ns)
{
    uint8_t src_code;
    uint8_t offset_bytes[4];

    switch (source) {
    case TRIG_SOURCE_GPIO:        src_code = FPGA_TRIG_SRC_GPIO; break;
    case TRIG_SOURCE_UART_WORD:   src_code = FPGA_TRIG_SRC_UART; break;
    case TRIG_SOURCE_POWER_ENV:   src_code = FPGA_TRIG_SRC_POWER_ENV; break;
    case TRIG_SOURCE_MANUAL:      src_code = FPGA_TRIG_SRC_MANUAL; break;
    case TRIG_SOURCE_TIMER:       src_code = FPGA_TRIG_SRC_TIMER; break;
    case TRIG_SOURCE_EXT_SYNC:    src_code = FPGA_TRIG_SRC_EXT_SYNC; break;
    default:                      src_code = FPGA_TRIG_SRC_GPIO; break;
    }

    /* Write trigger source */
    fpga_write_reg(FPGA_REG_TRIGGER_SRC, &src_code, 1);

    /* Write trigger offset (32-bit little-endian) */
    offset_bytes[0] = (offset_ns >> 0)  & 0xFF;
    offset_bytes[1] = (offset_ns >> 8)  & 0xFF;
    offset_bytes[2] = (offset_ns >> 16) & 0xFF;
    offset_bytes[3] = (offset_ns >> 24) & 0xFF;
    fpga_write_reg(FPGA_REG_TRIGGER_OFFSET, offset_bytes, 4);

    /* Clear status */
    uint8_t clear = 0x00;
    fpga_write_reg(FPGA_REG_STATUS, &clear, 1);

    /* Arm: write 0x01 to trigger control */
    uint8_t arm = 0x01;
    fpga_write_reg(FPGA_REG_TRIGGER_CTRL, &arm, 1);

    g_fpga_status = FPGA_STATUS_ARMED;
}

bool fpga_glitch_fired(void)
{
    uint8_t status;
    fpga_read_reg(FPGA_REG_STATUS, &status, 1);
    g_fpga_status = status;
    return (status & FPGA_STATUS_FIRED) != 0;
}

bool fpga_trigger_timed_out(void)
{
    uint8_t status;
    fpga_read_reg(FPGA_REG_STATUS, &status, 1);
    g_fpga_status = status;
    return (status & FPGA_STATUS_TIMEOUT) != 0;
}

void fpga_disarm(void)
{
    uint8_t disarm = 0x00;
    fpga_write_reg(FPGA_REG_TRIGGER_CTRL, &disarm, 1);
    g_fpga_status = 0;
}

uint8_t fpga_get_version(void)
{
    uint8_t ver;
    fpga_read_reg(FPGA_REG_VERSION, &ver, 1);
    return ver;
}

/* ---- End of file --------------------------------------------------- */