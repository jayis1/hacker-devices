/*
 * display.c — SSD1306 128x64 OLED driver (SPI, 4-wire)
 *
 * Author: jayis1
 * License: GPL-2.0
 *
 * Minimal text renderer: 8 lines × 21 chars (5x7 font) plus a tiny
 * bar-graph primitive for channel activity. No external font table —
 * we ship a compact 5x7 ASCII subset inline.
 */

#include "../board.h"
#include "../registers.h"
#include "display.h"
#include <string.h>

/* ---- 5x7 font (printable ASCII 0x20..0x7F) — compact subset ---- */
static const uint8_t font5x7[][5] = {
    {0x00,0x00,0x00,0x00,0x00}, /* space */
    {0x00,0x00,0x5F,0x00,0x00}, /* ! */
    {0x00,0x07,0x00,0x07,0x00}, /* " */
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    {0x02,0x01,0x02,0x04,0x02}, /* ~ */
};

static uint8_t vram[128 * 64 / 8];   /* 1 KiB frame buffer */

/* ---- Low-level SPI write (command vs data) ---- */
static void oled_cmd(uint8_t c) {
    GPIO_CLR(GPIOA, PA0_OLED_DC);   /* command */
    GPIO_CLR(GPIOC, PC13_OLED_CS);
    SPI1->DR = c;
    while (!(SPI1->SR & SPI_SR_RXNE)) { }
    (void)SPI1->DR;
    GPIO_SET(GPIOC, PC13_OLED_CS);
}
static void oled_data(uint8_t d) {
    GPIO_SET(GPIOA, PA0_OLED_DC);   /* data */
    GPIO_CLR(GPIOC, PC13_OLED_CS);
    SPI1->DR = d;
    while (!(SPI1->SR & SPI_SR_RXNE)) { }
    (void)SPI1->DR;
    GPIO_SET(GPIOC, PC13_OLED_CS);
}

void display_init(void) {
    GPIO_CLR(GPIOA, PA1_OLED_RST);
    for (volatile int i = 0; i < 10000; i++) __asm volatile("nop");
    GPIO_SET(GPIOA, PA1_OLED_RST);

    oled_cmd(0xAE);   /* display off */
    oled_cmd(0xD5); oled_cmd(0x80);   /* clock divide */
    oled_cmd(0xA8); oled_cmd(0x3F);   /* mux ratio 64 */
    oled_cmd(0xD3); oled_cmd(0x00);   /* display offset */
    oled_cmd(0x40);                   /* start line 0 */
    oled_cmd(0x8D); oled_cmd(0x14);   /* charge pump on */
    oled_cmd(0x20); oled_cmd(0x00);   /* horizontal addressing */
    oled_cmd(0xA1);                   /* segment remap */
    oled_cmd(0xC8);                   /* scan direction */
    oled_cmd(0xDA); oled_cmd(0x12);   /* com pins */
    oled_cmd(0x81); oled_cmd(0xCF);   /* contrast */
    oled_cmd(0xD9); oled_cmd(0xF1);   /* pre-charge */
    oled_cmd(0xDB); oled_cmd(0x40);   /* vcomh */
    oled_cmd(0xA4);                   /* display = vram */
    oled_cmd(0xA6);                   /* normal (not inverted) */
    oled_cmd(0xAF);                   /* display on */

    display_clear();
    display_flush();
}

void display_clear(void) { memset(vram, 0, sizeof(vram)); }

void display_text(int col, int row, const char *s) {
    if (row < 0 || row >= 8 || col < 0) return;
    int x = col * 6;
    while (*s && x < 128 - 5) {
        uint8_t c = (uint8_t)*s++;
        if (c < 0x20 || c > 0x7E) c = '?';
        const uint8_t *g = font5x7[c - 0x20];
        for (int i = 0; i < 5; i++) {
            uint8_t col8 = g[i];
            for (int b = 0; b < 7; b++) {
                int px = x + i;
                int py = row * 8 + b;
                if (col8 & (1 << b)) {
                    vram[(py / 8) * 128 + px] |= (1 << (py & 7));
                }
            }
        }
        x += 6;
    }
}

void display_bar(int x, int y, int w, int h, int fill_pct) {
    if (fill_pct < 0) fill_pct = 0;
    if (fill_pct > 100) fill_pct = 100;
    /* outline */
    for (int i = 0; i < w; i++) {
        vram[(y / 8) * 128 + x + i] |= (1 << y);
        vram[((y + h - 1) / 8) * 128 + x + i] |= (1 << ((y + h - 1) & 7));
    }
    int fw = (w * fill_pct) / 100;
    for (int i = 1; i < fw; i++) {
        for (int j = 1; j < h - 1; j++) {
            int py = y + j;
            vram[(py / 8) * 128 + x + i] |= (1 << (py & 7));
        }
    }
}

void display_flush(void) {
    for (int p = 0; p < 8; p++) {
        oled_cmd(0xB0 + p);          /* page address */
        oled_cmd(0x00);               /* lower column */
        oled_cmd(0x10);               /* upper column */
        for (int c = 0; c < 128; c++) {
            oled_data(vram[p * 128 + c]);
        }
    }
}